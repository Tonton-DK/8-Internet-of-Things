## Assignment 2/MQTT publisher/main/Kconfig.projbuild
```kconfig
menu "Dynamic Configuration"

    config PERIOD
        int "Period"
        default 1
        help
            The exact average period of publications.

    config WIFI_SSID
        string "WIFI SSID"
        default "SkyNet"
        help
            The SSID to connect to.

    config WIFI_PASSWORD
        string "WIFI Password"
        default "Summer"
        help
            The password to be used for connecting to the WiFi network.

    config MQTT_BROKER
        string "MQTT Broker"
        default "mqtt://broker.hivemq.com"
        help
            The MQTT broker to connect to (without auth).

    config MQTT_TOPIC
        string "MQTT Topic"
        default "org/sdu/2023/iot/my/name"
        help
            The topic on the MQTT broker to publish to.

endmenu

menu "Static Configuration"

    config ADC_CHANNEL
        string "ADC Channel"
        default "ADC_CHANNEL_6"
        help
            The pin (on the ESP32) connected to the sensor output.

    config ADC_UNIT
        string "ADC Unit"
        default "ADC_UNIT_1"
        help
            Which ADC to use.

endmenu

menu "Advanced WiFi Configuration"

    choice ESP_WIFI_SAE_MODE
        prompt "WPA3 SAE mode selection"
        default ESP_WPA3_SAE_PWE_BOTH
        help
            Select mode for SAE as Hunt and Peck, H2E or both.
        config ESP_WPA3_SAE_PWE_HUNT_AND_PECK
            bool "HUNT AND PECK"
        config ESP_WPA3_SAE_PWE_HASH_TO_ELEMENT
            bool "H2E"
        config ESP_WPA3_SAE_PWE_BOTH
            bool "BOTH"
    endchoice

    config ESP_WIFI_PW_ID
        string "PASSWORD IDENTIFIER"
        depends on  ESP_WPA3_SAE_PWE_HASH_TO_ELEMENT|| ESP_WPA3_SAE_PWE_BOTH
        default ""
        help
            password identifier for SAE H2E

    config ESP_MAXIMUM_RETRY
        int "Maximum retry"
        default 5
        help
            Set the Maximum retry to avoid station reconnecting to the AP unlimited when the AP is really inexistent.

    choice ESP_WIFI_SCAN_AUTH_MODE_THRESHOLD
        prompt "WiFi Scan auth mode threshold"
        default ESP_WIFI_AUTH_WPA2_PSK
        help
            The weakest authmode to accept in the scan mode.
            This value defaults to ESP_WIFI_AUTH_WPA2_PSK incase password is present and ESP_WIFI_AUTH_OPEN is used.
            Please select ESP_WIFI_AUTH_WEP/ESP_WIFI_AUTH_WPA_PSK incase AP is operating in WEP/WPA mode.

        config ESP_WIFI_AUTH_OPEN
            bool "OPEN"
        config ESP_WIFI_AUTH_WEP
            bool "WEP"
        config ESP_WIFI_AUTH_WPA_PSK
            bool "WPA PSK"
        config ESP_WIFI_AUTH_WPA2_PSK
            bool "WPA2 PSK"
        config ESP_WIFI_AUTH_WPA_WPA2_PSK
            bool "WPA/WPA2 PSK"
        config ESP_WIFI_AUTH_WPA3_PSK
            bool "WPA3 PSK"
        config ESP_WIFI_AUTH_WPA2_WPA3_PSK
            bool "WPA2/WPA3 PSK"
        config ESP_WIFI_AUTH_WAPI_PSK
            bool "WAPI PSK"
    endchoice

endmenu
```
